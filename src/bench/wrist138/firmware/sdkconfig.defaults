## src/bench/wrist138/firmware/sdkconfig.defaults
```kconfig
CONFIG_IDF_TARGET="esp32s3"
CONFIG_ESP_CONSOLE_NONE=y
CONFIG_LOG_DEFAULT_LEVEL_NONE=y
CONFIG_ESP_MAIN_TASK_STACK_SIZE=4096
```

## src/firmware/can_reader144/sdkconfig.defaults
```kconfig
CONFIG_IDF_TARGET="esp32s3"
CONFIG_ESPTOOLPY_FLASHSIZE_16MB=y
CONFIG_ESPTOOLPY_FLASHMODE_DIO=y
CONFIG_ESPTOOLPY_FLASHFREQ_40M=y
CONFIG_PARTITION_TABLE_CUSTOM=y
CONFIG_PARTITION_TABLE_CUSTOM_FILENAME="partitions.csv"
CONFIG_ESP_CONSOLE_NONE=y
CONFIG_LOG_DEFAULT_LEVEL_NONE=y
CONFIG_FREERTOS_HZ=1000
CONFIG_ESP_TASK_WDT_EN=y
CONFIG_ESP_TASK_WDT_INIT=y
```

## src/firmware/main/Kconfig.projbuild
```kconfig
menu "robot-arm-lab preparation"

config ROBOT_LAB_HARDWARE_PROFILE_APPROVED
    bool "Hardware profile approval record (inactive in ST2)"
    default n
    help
        This preparation skeleton has no approved physical hardware profile.
        Leave this option disabled. Enabling it only produces a warning log;
        app_main keeps effective physical approval false. The default entry starts no
        network or CAN transport. The separate prepared runtime option may start
        SoftAP/HTTP, but still cannot authorize CAN, torque or motion.
        Actual hardware approval and transport integration require a later
        reviewed implementation and physical acceptance evidence.

config ROBOT_LAB_PREPARED_RUNTIME
    bool "Compile prepared owner/SoftAP/HTTP execution entry"
    default n
    help
        Offline build candidate only. Hardware approvals remain immutable false.
        Flashing and physical networking/motion require separate acceptance.

endmenu
```
